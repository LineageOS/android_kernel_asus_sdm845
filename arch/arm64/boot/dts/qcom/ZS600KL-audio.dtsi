&snd_934x {
  qcom,audio-routing =
    "AIF4 VI", "MCLK",
    "RX_BIAS", "MCLK",
    "MADINPUT", "MCLK",
    "hifi amp", "LINEOUT1",
    "hifi amp", "LINEOUT2",
    "AMIC1", "MIC BIAS1",
    "MIC BIAS1", "Handset Mic",        //bsp ++
    "AMIC2", "MIC BIAS2",
    "MIC BIAS2", "Headset Mic",
    "AMIC3", "MIC BIAS1",        
    "MIC BIAS1", "Handset Mic second", //bsp ++
    "AMIC4", "MIC BIAS2",
    "MIC BIAS1", "Digital Mic0",
    "DMIC1", "MIC BIAS1",
    "MIC BIAS1", "Digital Mic1",
    "DMIC2", "MIC BIAS3",
    "MIC BIAS3", "Digital Mic2",
    "DMIC3", "MIC BIAS3",
    "MIC BIAS3", "Digital Mic3",
    "DMIC4", "MIC BIAS4",
    "MIC BIAS4", "Digital Mic4",
    "DMIC5", "MIC BIAS4",
    "MIC BIAS4", "Digital Mic5",
    "SpkrLeft IN", "SPK1 OUT",
    "SpkrRight IN", "SPK2 OUT";

  AUDIO_DEBUG = <&tlmm 122 0>;
  
  qcom,msm-mbhc-hphl-swh = <1>;
  qcom,msm-mbhc-gnd-swh = <1>;
  qcom,msm-mbhc-hs-mic-max-threshold-mv = <1700>;
  qcom,msm-mbhc-hs-mic-min-threshold-mv = <50>;
  qcom,hph-en0-gpio = <&tavil_hph_en0>;
  qcom,hph-en1-gpio = <&tavil_hph_en1>;
  qcom,tavil-mclk-clk-freq = <9600000>;

  asoc-codec = <&stub_codec>, <&ext_disp_audio_codec>;
  asoc-codec-names = "msm-stub-codec.1",
         "msm-ext-disp-audio-codec-rx";

  qcom,usbc-analog-en1-gpio = <&wcd_usbc_analog_en1_gpio>;
  qcom,usbc-analog-en2-gpio = <&tlmm 51 0>;
  pinctrl-names = "aud_active", "aud_sleep";
  pinctrl-0 = <&wcd_usbc_analog_en2_active>;
  pinctrl-1 = <&wcd_usbc_analog_en2_idle>;

};
