//ASUS_BSP Audio Amp +++
&qupv3_se4_i2c {
       status = "ok";
	tfa98xx@34 {
		compatible = "nxp,tfa98xx";
		reg = <0x34>;
	};
	tfa98xx@35 {
		compatible = "nxp,tfa98xx";
		reg = <0x35>;
        };
};
//ASUS_BSP Audio Amp +++

&snd_934x {
  qcom,audio-routing =
    "AIF4 VI", "MCLK",
    "RX_BIAS", "MCLK",
    "MADINPUT", "MCLK",
    "hifi amp", "LINEOUT1",
    "hifi amp", "LINEOUT2",
    "AMIC1", "MIC BIAS1",        
    "MIC BIAS1", "Handset Mic",  
    "AMIC2", "MIC BIAS2",
    "MIC BIAS2", "Headset Mic",
    "AMIC3", "MIC BIAS3",        
    "MIC BIAS3", "Handset Mic second", 
    "AMIC4", "MIC BIAS4",        
    "MIC BIAS4", "Handset Mic third", 
    "AMIC4", "MIC BIAS2",
    "MIC BIAS1", "Digital Mic0",
    "DMIC1", "MIC BIAS1",
    "MIC BIAS1", "Digital Mic1",
    "DMIC2", "MIC BIAS3",
    "MIC BIAS3", "Digital Mic2",
    "DMIC3", "MIC BIAS3",
    "MIC BIAS3", "Digital Mic3",
    "DMIC4", "MIC BIAS4",
    "MIC BIAS4", "Digital Mic4",
    "DMIC5", "MIC BIAS4",
    "MIC BIAS4", "Digital Mic5",
    "SpkrLeft IN", "SPK1 OUT",
    "SpkrRight IN", "SPK2 OUT";
  
  qcom,msm-mbhc-hphl-swh = <1>;
  qcom,msm-mbhc-gnd-swh = <1>;
  qcom,msm-mbhc-hs-mic-max-threshold-mv = <2550>;
  qcom,msm-mbhc-hs-mic-min-threshold-mv = <50>;
  qcom,hph-en0-gpio = <&tavil_hph_en0>;
  qcom,hph-en1-gpio = <&tavil_hph_en1>;
  qcom,tavil-mclk-clk-freq = <9600000>;

  asoc-codec = <&stub_codec>, <&ext_disp_audio_codec>;
  asoc-codec-names = "msm-stub-codec.1",
         "msm-ext-disp-audio-codec-rx";

  pinctrl-names = "quat-mi2s-active", "quat-mi2s-sleep";
  pinctrl-0 = <&quat_mi2s_active &quat_mi2s_sd0_active &quat_mi2s_sd1_active>;
  pinctrl-1 = <&quat_mi2s_sleep &quat_mi2s_sd0_sleep &quat_mi2s_sd1_sleep>; 

};
