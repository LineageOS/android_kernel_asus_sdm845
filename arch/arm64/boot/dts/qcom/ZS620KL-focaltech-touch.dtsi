// ASUS_BSP_Touch +++
&qupv3_se5_i2c {
	status = "ok";
	focaltech@38 {
		compatible = "focaltech,fts";
		reg = <0x38>;
		interrupt-parent = <&tlmm>;
		interrupts = <125 0x2008>;
		//vdd-supply = <&pm8998_l28>;
		vcc_i2c-supply = <&pm8998_l14>;
		/* pins used by touchscreen */
		pinctrl-names = "pmx_ts_active","pmx_ts_suspend","pmx_ts_release";
		pinctrl-0 = <&ts_int_active &ts_reset_active>;
		pinctrl-1 = <&ts_int_suspend &ts_reset_suspend>;
		pinctrl-2 = <&ts_release>;
		focaltech,name = "ft8716";
		//focaltech,family-id = <0x58>;
		focaltech,reset-gpio = <&tlmm 99 0x0>;
		focaltech,irq-gpio = <&tlmm 125 0x0>;
		focaltech,display-coords = <0 0 1080 2246>;
		//focaltech,panel-coords = <0 0 1080 2246>;
		//focaltech,button-map= <139 102 158>;
		//focaltech,have-key;
		//focaltech,key-number = <3>;
		focaltech,max-touch-number = <10>;
		//focaltech,keys = <158 102 139>;
		//focaltech,key-y-coord = <2000>;
		//focaltech,key-x-coord = <200 400 600>;
	};
};
// ASUS_BSP_Touch ---
