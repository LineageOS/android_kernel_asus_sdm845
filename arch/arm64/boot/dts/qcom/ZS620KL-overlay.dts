/* Copyright (c) 2017, The Linux Foundation. All rights reserved.
 *
 * This program is free software; you can redistribute it and/or modify
 * it under the terms of the GNU General Public License version 2 and
 * only version 2 as published by the Free Software Foundation.
 *
 * This program is distributed in the hope that it will be useful,
 * but WITHOUT ANY WARRANTY; without even the implied warranty of
 * MERCHANTABILITY or FITNESS FOR A PARTICULAR PURPOSE.  See the
 * GNU General Public License for more details.
 */

/dts-v1/;
/plugin/;

#include <dt-bindings/clock/qcom,gcc-sdm845.h>
#include <dt-bindings/clock/qcom,camcc-sdm845.h>
#include <dt-bindings/clock/qcom,dispcc-sdm845.h>
#include <dt-bindings/clock/qcom,rpmh.h>
#include <dt-bindings/interrupt-controller/arm-gic.h>

#include "sdm845-sde-display.dtsi"
#include "sdm845-mtp.dtsi"
#include "ZS620KL-pinctrl-overlay.dtsi"
#include "sdm845-audio-overlay.dtsi"
#include "ZS620KL-focaltech-touch.dtsi"
#include "ZS620KL-camera-sensor.dtsi"
#include "ZS620KL-gpio-key.dtsi"

#include "ZS620KL-audio-ER2.dtsi"
#include "ZS620KL-usb-ER3.dtsi"
#include "ZS620KL-modem-overlay.dtsi"
#include "ZS620KL-pmic.dtsi"
#include "dsi-panel-AUO-H618DAX01-video.dtsi"
#include "ZS620KL-goodix-fp.dtsi"
#include "ZS620KL-sensors.dtsi"
#include "ZS620KL-mtp-bt-overlay.dtsi"

/ {
	model = "Qualcomm Technologies, Inc. SDM845 v2 MTP";
	compatible = "qcom,sdm845-mtp", "qcom,sdm845", "qcom,mtp";
	qcom,msm-id = <321 0x20000>;
	qcom,board-id = <47 0>;
};
