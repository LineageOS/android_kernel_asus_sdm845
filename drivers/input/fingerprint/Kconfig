## drivers/input/fingerprint/Kconfig
```kconfig
config GOODIX_FINGERPRINT
	tristate "generic goodix fingerprint driver"
	default m
	help
	add support for goodix fingerprint driver.
	To compile this driver as a module, choose M here: the
	  module will be called fingerprint.
```

## drivers/input/touchscreen/focaltech_touch/Kconfig
```kconfig
#
# Focaltech Touchscreen driver configuration
#

config TOUCHSCREEN_FTS
	tristate "Focaltech touch device driver"
	depends on I2C
	default n
	help
	Say Y here if you have Focaltech touch panel.
	If unsure, say N.

config TOUCHSCREEN_FTS_DIRECTORY
    string "Focaltech ts directory name"
    default "focaltech_touch"
    depends on TOUCHSCREEN_FTS
    
```

## kernel/Kconfig.freezer
```kconfig
config FREEZER
	def_bool PM_SLEEP || CGROUP_FREEZER

config PANIC_ON_OOPS_VALUE
	int "Enable panic on oops"
	default "1"
```
